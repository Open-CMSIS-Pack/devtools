# SVDTiny register map
Vendor: ARM; Series: ARM_Ref; File version: 1.0
SVD Reference Description MCU V1.0, with ARM 32-bit Cortex-M3 Microcontroller, CPU clock up to 80MHz
CPU: CM3 r18p52, little endian, 4 interrupt priority bits
Registers are 32-bit, read-write, no defined reset value unless marked. A register's access mark holds for its fields unless they carry their own. Offsets are from the block's base; lines under a group give offsets from that group; [hi:lo] are bit positions; {n}, {i} and the like mark numbered series; 'fields as' and 'values as' point back to an identical list; <NAME> marks a mode.

## Memory map
0x400C2000 Peri size 0x100 — Peripheral testing for []

## Interrupts
2 Peri — Peri Interrupt

## Peri — Peripheral testing for []
Base 0x400C2000
{0x0+4i} CTRL[{i}] (i=0..3) — Memory System Control Register
0x20 Data[0] — Data Register 0
