# option_n register map
File version: 1.5
option_n Test (Override SFD/SFR name)
CPU: CM4 r1p5, little endian, FPU, 4 interrupt priority bits, 20 interrupts
Registers are 32-bit, read-write, reset 0x0 unless marked. A register's access mark holds for its fields unless they carry their own. Offsets are from the block's base; lines under a group give offsets from that group; [hi:lo] are bit positions; {n}, {i} and the like mark numbered series; 'fields as' and 'values as' point back to an identical list; <NAME> marks a mode.

## Memory map
0x40003000 IWDG size 0x400 — Independent watchdog
0x40004000 IWDG2 size 0x400 — Independent watchdog 2
0xE000EE08 DCB size 0x40 — Debug Control Block

## Interrupts
2 IWDG — IWDG Interrupt

## IWDG — Independent watchdog
Base 0x40003000
Same registers: IWDG2 0x40004000
0x00 KR wo — Key register
  [15:0] KEY — Key value (write only, read 0x0000)
0x04 PR — Prescaler register
  [7:0] PR — Prescaler divider

## DCB — Debug Control Block
Base 0xE000EE08
0x00 DSCSR_Clust group — Expression test for Register in Cluster
  0x00 DSCSR — Debug Security Control and Status Register
    [16] CDS — Current domain Secure
      0=Disable (Current domain Secure disabled); 1=Enable (Current domain Secure enabled)
  0x04 OtherReg — Some other Register
0x08 DSCSR — Debug Security Control and Status Register
  fields as DSCSR_Clust.DSCSR
