# ResetMask register map
Vendor: TestVendor; Series: TEST; File version: 100
Default
CPU: other r0p0, little endian, MPU, FPU, vendor SysTick, 4 interrupt priority bits
Registers are 64-bit, read-write, reset 0x0 unless marked. A register's access mark holds for its fields unless they carry their own. Offsets are from the block's base; lines under a group give offsets from that group; [hi:lo] are bit positions; {n}, {i} and the like mark numbered series; 'fields as' and 'values as' point back to an identical list; <NAME> marks a mode.

## Memory map
0x00000000 RESET_MASK size 0xC

## RESET_MASK
Base 0x00000000
0x00 TIMER — Timer TestReg
  [63:0] TIMER — System timer bits.
0x00 TIMER2 65-bit — Timer TestReg
  [63:0] TIMER — System timer bits.
0x08 TestRegister 32-bit
  [31:0] TestBitfield write-1-clears

## Licence text in the file
Test case
