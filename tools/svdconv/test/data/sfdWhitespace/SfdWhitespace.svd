# SfdWhitespace register map
File version: 1.0
Test whitespace and display breaks in SFD descriptions
CPU: CM3 r0p0, little endian, no MPU, no FPU, VTOR, 4 interrupt priority bits
Registers are 32-bit, read-write, reset 0x0 unless marked. A register's access mark holds for its fields unless they carry their own. Offsets are from the block's base; lines under a group give offsets from that group; [hi:lo] are bit positions; {n}, {i} and the like mark numbered series; 'fields as' and 'values as' point back to an identical list; <NAME> marks a mode.

## Memory map
0x40000000 TEST size 0x4 — Test peripheral

## TEST — Test peripheral
Base 0x40000000
0x00 CTRL — Register description. Explicit register line
  [0] ENABLE — Field text. Explicit field line
    0=OFF (Disabled state); 1=ON (Enabled state. Explicit enum line)
